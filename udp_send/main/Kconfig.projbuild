## udp_send/main/Kconfig.projbuild
```kconfig
menu "Project Configuration"

config WIFI_SSID
    string "WiFi SSID"

config WIFI_PASS
    string "WiFi password"

config BROADCAST_PORT
    int "Port ESP broadcasts to"
    default 5555
    
endmenu
```

## udp_send/sdkconfig.defaults
```kconfig
CONFIG_WIFI_SSID="your-ssid-here"
CONFIG_WIFI_PASS="your-pass-here"
CONFIG_UDP_SERVER_IP="your server ip"
CONFIG_UDP_SERVER_PORT="your server port"
```
